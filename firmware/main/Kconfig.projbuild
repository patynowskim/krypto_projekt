## firmware/main/Kconfig.projbuild
```kconfig
menu "Satlink"

    choice SATLINK_ROLE
        prompt "Default node role"
        default SATLINK_ROLE_CUBESAT
        config SATLINK_ROLE_CUBESAT
            bool "CubeSat (TX telemetry, RX telecommands)"
        config SATLINK_ROLE_GCS
            bool "Ground station (TX telecommands, RX telemetry)"
    endchoice

    config SATLINK_WIFI_CHANNEL
        int "ESP-NOW Wi-Fi channel"
        range 1 13
        default 1
        help
            Both nodes must use the same channel. No AP association is required.

    config SATLINK_TM_INTERVAL_MS
        int "Housekeeping telemetry interval (ms), 0 = off"
        range 0 60000
        default 1000

endmenu
```

## firmware/sdkconfig.defaults
```kconfig
CONFIG_ESPTOOLPY_FLASHSIZE_4MB=y
CONFIG_PARTITION_TABLE_SINGLE_APP=y
CONFIG_ESP_CONSOLE_UART_DEFAULT=y
CONFIG_ESP_CONSOLE_UART_BAUDRATE=115200
CONFIG_LOG_DEFAULT_LEVEL_INFO=y
CONFIG_MBEDTLS_HARDWARE_AES=y
CONFIG_MBEDTLS_HARDWARE_MPI=y
CONFIG_ESP_WIFI_SOFTAP_SUPPORT=n
CONFIG_ESP_TASK_WDT_TIMEOUT_S=10
CONFIG_FREERTOS_HZ=1000
CONFIG_BT_ENABLED=n
CONFIG_SATLINK_WIFI_CHANNEL=1
CONFIG_SATLINK_ROLE_CUBESAT=y
```
